## buildroot/configs/armv7-linux-3.x-musl_defconfig
```kconfig
BR2_arm=y
BR2_cortex_a9=y
BR2_ARM_EABIHF=y
BR2_TOOLCHAIN_BUILDROOT_MUSL=y
BR2_STATIC_LIBS=y
BR2_TOOLCHAIN_BUILDROOT_CXX=n
BR2_INIT_NONE=y
BR2_SYSTEM_BIN_SH_BUSYBOX=y
BR2_ROOTFS_DEVICE_CREATION_STATIC=y
BR2_TARGET_GENERIC_HOSTNAME="grit-armv7"
BR2_TARGET_GENERIC_ISSUE="griTTYkit armv7 payload"
BR2_PACKAGE_BUSYBOX=y
BR2_PACKAGE_BUSYBOX_CONFIG="package/busybox/busybox.config"
BR2_TARGET_ROOTFS_TAR=y
```

## buildroot/external/busierbox/Config.in
```kconfig
menu "BusierBox payload options"

source "$BR2_EXTERNAL_BUSIERBOX_PATH/package/busierbox-doom-ascii/Config.in"

endmenu
```

## buildroot/external/busierbox/package/busierbox-doom-ascii/Config.in
```kconfig
config BR2_PACKAGE_BUSIERBOX_DOOM_ASCII
	bool "busierbox doom-ascii"
	depends on BR2_USE_MMU
	help
	  Build doom-ascii, a doomgeneric-based terminal Doom port, as the
	  static BusierBox optional doom payload engine.

	  The engine is installed as /usr/bin/doom. Game data is not included;
	  stage a legally usable WAD separately.
```

## buildroot/external/griTTYkit/Config.in
```kconfig
menu "griTTYkit payload options"

source "$BR2_EXTERNAL_GRIPTYKIT_PATH/package/grit-doom-ascii/Config.in"

endmenu
```

## buildroot/external/griTTYkit/package/grit-doom-ascii/Config.in
```kconfig
config BR2_PACKAGE_GRIT_DOOM_ASCII
	bool "grit doom-ascii"
	depends on BR2_USE_MMU
	help
	  Build doom-ascii, a doomgeneric-based terminal Doom port, as the
	  static griTTYkit optional doom payload engine.

	  The engine is installed as /usr/bin/doom. Game data is not included;
	  stage a legally usable WAD separately.
```
